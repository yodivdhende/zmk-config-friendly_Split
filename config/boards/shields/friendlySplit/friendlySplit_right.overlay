#include "friendlySplit.dtsi" 

&default_transform { 
    col-offset = <7>;
};

&kscan0 {
        col-gpios
            = <&pro_micro 9 GPIO_ACTIVE_HIGH>  // col7 in the schematic 
            , <&pro_micro 8 GPIO_ACTIVE_HIGH>  // col8 in the schematic
            , <&pro_micro 7 GPIO_ACTIVE_HIGH>  // col9 in the schematic
            , <&pro_micro 6 GPIO_ACTIVE_HIGH>  // col10 in the schematic
            , <&pro_micro 5 GPIO_ACTIVE_HIGH>  // col11 in the schematic
            , <&pro_micro 4 GPIO_ACTIVE_HIGH> // col12 in the schematic 
            , <&pro_micro 3 GPIO_ACTIVE_HIGH> // col13 in the schematic 
            , <&pro_micro 2 GPIO_ACTIVE_HIGH>  // col14 in the schematic 
            , <&pro_micro 14 GPIO_ACTIVE_HIGH>  // col15 in the schematic 
            ; 
        
        row-gpios
            = <&pro_micro 15 (GPIO_ACTIVE_HIGH | GPIO_PULL_DOWN)> // Row A from the schematic file
            , <&pro_micro 18 (GPIO_ACTIVE_HIGH | GPIO_PULL_DOWN)> // Row B from the schematic file
            , <&pro_micro 19 (GPIO_ACTIVE_HIGH | GPIO_PULL_DOWN)> // Row C from the schematic file
            , <&pro_micro 20 (GPIO_ACTIVE_HIGH | GPIO_PULL_DOWN)> // Row D from the schematic file
            , <&pro_micro 21 (GPIO_ACTIVE_HIGH | GPIO_PULL_DOWN)> // Row E from the schematic file
            ;
};
