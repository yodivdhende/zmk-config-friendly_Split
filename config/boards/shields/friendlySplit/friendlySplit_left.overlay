#include "friendly_Split.dtsi" 

&kscan0 {
  col-gpios
      = <&pro_micro 21 GPIO_ACTIVE_HIGH> // col0 in the schematic
      , <&pro_micro 20 GPIO_ACTIVE_HIGH> // col1 in the schematic
      , <&pro_micro 16 GPIO_ACTIVE_HIGH> // col2 in the schematic
      , <&pro_micro 19 GPIO_ACTIVE_HIGH> // col3 in the schematic
      , <&pro_micro 18 GPIO_ACTIVE_HIGH> // col4 in the schematic
      , <&pro_micro 15 GPIO_ACTIVE_HIGH> // col5 in the schematic
      , <&pro_micro 14 GPIO_ACTIVE_HIGH> // col6 in the schematic
      ;

  row-gpios
      = <&pro_micro 2 (GPIO_ACTIVE_HIGH | GPIO_PULL_DOWN)> // Row A from the schematic file
      , <&pro_micro 3 (GPIO_ACTIVE_HIGH | GPIO_PULL_DOWN)> // Row B from the schematic file
      , <&pro_micro 4 (GPIO_ACTIVE_HIGH | GPIO_PULL_DOWN)> // Row C from the schematic file
      , <&pro_micro 5 (GPIO_ACTIVE_HIGH | GPIO_PULL_DOWN)> // Row D from the schematic file
      , <&pro_micro 6 (GPIO_ACTIVE_HIGH | GPIO_PULL_DOWN)> // Row E from the schematic file
      ;
};