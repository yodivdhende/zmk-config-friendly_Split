## config/boards/shields/friendly_Split/Kconfig.defconfig
```kconfig
if SHIELD_FRIENDLY_SPLIT_LEFT

config ZMK_KEYBOARD_NAME
    default "friendlySplit"

config ZMK_SPLIT_ROLE_CENTRAL
    default y

endif

if SHIELD_FRIENDLY_SPLIT_LEFT || SHIELD_FRIENDLY_SPLIT_RIGHT

config ZMK_SPLIT
    default y

endif
```

## config/boards/shields/friendly_Split/Kconfig.shield
```kconfig
config SHIELD_FRIENDLY_SPLIT_LEFT
  def_bool $(shields_list_contains, friendly_Split_left)

config SHIELD_FRIENDLY_SPLIT_RIGHT
  def_bool $(shields_list_contains, friendly_Split_right)
```
